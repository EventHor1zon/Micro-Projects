## online_accelerometer/main/Kconfig.projbuild
```kconfig
menu "Example Configuration"

config WIFI_SSID
    string "WiFi SSID"
	default "myssid"
	help
		SSID (network name) for the example to connect to.

config WIFI_PASS
    string "WiFi Password"
	default "mypassword"
	help
		WiFi password (WPA or WPA2) for the example to use.
		Can be left blank if the network has no security set.

config SERVER_ADDR
    string "Server Addr"
    default "192.168.0.4"
    help
	IPv4 address of the server

config SERVER_PORT
    int "Port"
    range 0 65535
    default 3333
    help
        Local port the example server will listen on.

endmenu
```
